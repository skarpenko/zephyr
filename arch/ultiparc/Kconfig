## arch/ultiparc/Kconfig
```kconfig
#
# Copyright (c) 2018 Stepan Karpenko <stepan.karpenko@gmail.com>
#
# SPDX-License-Identifier: Apache-2.0
#

choice
	prompt "Ultiparc configuration selection"
	depends on ULTIPARC
	gsource "arch/ultiparc/soc/*/Kconfig.soc"
endchoice

menu "Ultiparc Options"
	depends on ULTIPARC

config ARCH
	string
	default "ultiparc"

config ARCH_DEFCONFIG
	string
	default "arch/ultiparc/defconfig"

menu "Ultiparc Processor Options"

config GEN_ISR_TABLES
	default y

config GEN_IRQ_VECTOR_TABLE
	default n

endmenu

gsource "arch/ultiparc/soc/*/Kconfig"

endmenu
```

## boards/ultiparc/ultiparc-sim/Kconfig.board
```kconfig
config BOARD_ULTIPARC_SIM
	bool "Ultiparc simulator target"
	depends on SOC_ULTIPARC_RTL
```

## boards/ultiparc/ultiparc-sim/Kconfig.defconfig
```kconfig
if BOARD_ULTIPARC_SIM

config BUILD_OUTPUT_BIN
        default y

config BOARD
	default "ultiparc-sim"

endif
```

## boards/ultiparc/ultiparc-sim/ultiparc_sim_defconfig
```kconfig
CONFIG_ULTIPARC=y
CONFIG_SOC_ULTIPARC_RTL=y
CONFIG_BOARD_ULTIPARC_SIM=y
CONFIG_ULTIPARC_TIMER=y
CONFIG_ULTIPARC_ICTL=y
CONFIG_CONSOLE=y
CONFIG_PRINTK=y
CONFIG_ULTIPARC_CONSOLE=y
CONFIG_STDOUT_CONSOLE=y
CONFIG_SERIAL=n
CONFIG_BOOT_BANNER=y
```

## boards/ultiparc/ultisoc-fpga/Kconfig.defconfig
```kconfig
if BOARD_ULTISOC_FPGA

config BUILD_OUTPUT_BIN
        default y

config BOARD
	default "ultisoc-fpga"

endif
```

## boards/ultiparc/ultisoc-fpga/ultisoc_fpga_defconfig
```kconfig
CONFIG_ULTIPARC=y
CONFIG_SOC_ULTISOC=y
CONFIG_BOARD_ULTISOC_FPGA=y
CONFIG_ULTIPARC_TIMER=y
CONFIG_ULTIPARC_ICTL=y
CONFIG_CONSOLE=y
CONFIG_PRINTK=y
# CONFIG_ULTISOC_CONSOLE=y
# CONFIG_STDOUT_CONSOLE=y
CONFIG_SERIAL=y
CONFIG_UART_ULTISOC=y
CONFIG_UART_ULTISOC_PORT_0=y
CONFIG_UART_CONSOLE=y
CONFIG_UART_INTERRUPT_DRIVEN=y
CONFIG_BOOT_BANNER=y
```

## drivers/interrupt_controller/Kconfig.ultiparc
```kconfig
#
# Copyright (c) 2018-2019 Stepan Karpenko <stepan.karpenko@gmail.com>
#
# SPDX-License-Identifier: Apache-2.0
#

if ULTIPARC

config ULTIPARC_ICTL
	bool "Ultiparc interrupt controller"
	default n
	help
	 Enable Ultiparc interrupt controller driver.

config ULTIPARC_ICTL_BASE_ADDRESS
	hex "Ultiparc interrupt controller base address"
	default 0x80200000
	depends on ULTIPARC_ICTL
	help
	  This options specifies the base I/O address of the Ultiparc
	  interrupt controller.

endif # ULTIPARC
```

## drivers/serial/Kconfig.ultisoc
```kconfig
# Kconfig.ultisoc - UltiSoC UART configuration options
#
# Copyright (c) 2019 Stepan Karpenko <stepan.karpenko@gmail.com>
#
# SPDX-License-Identifier: Apache-2.0
#

menuconfig UART_ULTISOC
	bool "UltiSoC serial driver"
	depends on SOC_ULTISOC
	select SERIAL_HAS_DRIVER
	select SERIAL_SUPPORT_INTERRUPT
	help
	  This option enables the UltiSoC serial driver.

# ---------- Port 0 ----------

menuconfig UART_ULTISOC_PORT_0
	bool "Enable UltiSoC UART port 0"
	depends on UART_ULTISOC
	help
	  This tells the driver to configure the UART port at boot, depending on
	  the additional configure options below.

config UART_ULTISOC_PORT_0_BASE_ADDRESS
	hex "Port 0 MMIO base"
	default 0x80000000
	depends on UART_ULTISOC_PORT_0
	help
	  Port 0 MMIO base address

config UART_ULTISOC_PORT_0_IRQ
	int "Port 0 IRQ"
	default 1
	depends on UART_ULTISOC_PORT_0
	help
	  Port 0 IRQ number

config UART_ULTISOC_PORT_0_IRQ_PRIORITY
	int "Port 0 interrupt priority"
	default 1
	depends on UART_ULTISOC_PORT_0
	help
	  Port 0 interrupt priority

config UART_ULTISOC_PORT_0_BAUD_RATE
	int "Port 0 baud rate"
	default 115200
	depends on UART_ULTISOC_PORT_0
	help
	  Port 0 baud rate

config UART_ULTISOC_PORT_0_CLK_FREQ
	int "Port 0 clock frequency"
	default 50000000
	depends on UART_ULTISOC_PORT_0
	help
	  Port 0 clock frequency (Hz)
```

## soc/ultiparc/ultiparc-rtl/Kconfig.defconfig
```kconfig
if SOC_ULTIPARC_RTL

config SOC
	string
	default "ultiparc-rtl"

config SYS_CLOCK_HW_CYCLES_PER_SEC
	int
	default 65000000

config NUM_IRQS
	int
	default 32

config RAM_BASE
	hex
	default	0x00000000

config RAM_SIZE
	hex
	default 0x40000

endif # SOC_ULTIPARC_RTL
```

## soc/ultiparc/ultisoc/Kconfig.defconfig
```kconfig
if SOC_ULTISOC

config SOC
	string
	default "ultisoc"

config SYS_CLOCK_HW_CYCLES_PER_SEC
	int
	default 50000000

config NUM_IRQS
	int
	default 32

config RAM_BASE
	hex
	default	0x01000000

config RAM_SIZE
	hex
	default 0x40000

endif # SOC_ULTISOC
```
